## main/Kconfig.projbuild
```kconfig
menu "Meet Companion Device"

config MEET_SERVER_URL
    string "Meet server origin URL"
    default "https://meet.refme.cc"
    help
        HTTPS origin of the private Meet backend (no trailing slash).

config MEET_IDLE_HANGUP_MS
    int "Idle hangup timeout (ms)"
    default 90000
    range 5000 600000
    help
        End Call and complete conversation after this idle period while InCall.

config MEET_USE_DEVICE_AEC
    bool "Enable device-side AEC"
    default y
    help
        Run AFE_TYPE_VC with the ES8388 reference channel during InCall.

config MEET_FIRMWARE_VERSION
    string "Companion firmware version"
    default "0.3.0"
    help
        Reported to Meet via PATCH /api/devices/me and compared during OTA check.

endmenu
```

## sdkconfig.defaults.esp32s3
```kconfig
# ESP32-S3 specific SPIRAM / cache
CONFIG_SPIRAM=y
CONFIG_SPIRAM_MODE_OCT=y
CONFIG_SPIRAM_SPEED_80M=y
CONFIG_SPIRAM_FETCH_INSTRUCTIONS=y
CONFIG_SPIRAM_RODATA=y
CONFIG_ESP32S3_INSTRUCTION_CACHE_16KB=y
CONFIG_ESP32S3_DATA_CACHE_32KB=y
CONFIG_ESP32S3_DATA_CACHE_LINE_64B=y
CONFIG_ESP_DEFAULT_CPU_FREQ_MHZ_240=y
CONFIG_ESPTOOLPY_FLASHSIZE_16MB=y
CONFIG_ESPTOOLPY_FLASHMODE_QIO=y
```
